## sdkconfig.defaults.esp32c6
```kconfig
CONFIG_PARTITION_TABLE_CUSTOM_FILENAME="partitions/v2/16m_c6.csv"
CONFIG_ESPTOOLPY_FLASHMODE_DIO=y
CONFIG_SR_WN_WN9S_NIHAOXIAOZHI=y

# 使用精简版证书包
CONFIG_MBEDTLS_CERTIFICATE_BUNDLE=y
CONFIG_MBEDTLS_CERTIFICATE_BUNDLE_DEFAULT_CMN=y
# CONFIG_MBEDTLS_CERTIFICATE_BUNDLE_DEFAULT_FULL is not set
# CONFIG_MBEDTLS_CERTIFICATE_BUNDLE_DEFAULT_NONE is not set
```
